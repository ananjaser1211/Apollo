## arch/arm64/configs/apollo_defconfig
```kconfig
#
#
# Apollo Defconfig
#
#
CONFIG_BOEFFLA_WL_BLOCKER=y
CONFIG_CUSTOM_FORCETOUCH=y
CONFIG_SEC_INPUT_BOOSTER=y
CONFIG_ARGOS=y
CONFIG_ARGOS_CLUSTER_NUM=2
CONFIG_PROC_AVC=y
CONFIG_PAGE_BOOST=y
CONFIG_PAGE_BOOST_RECORDING=y
CONFIG_PROCESS_RECLAIM=y
#
# Scheduler features
#
# CONFIG_PELT_HALFLIFE_32 is not set
CONFIG_PELT_HALFLIFE_16=y
# CONFIG_PELT_HALFLIFE_8 is not set
#
# SEC Memory Management Options
#
CONFIG_SEC_MM=y
```

## arch/arm64/configs/crownlte_defconfig
```kconfig
#
#
# crownlte Defconfig
#
#
CONFIG_VMPRESSURE_LEVEL_MED=70
# CONFIG_MUIC_UNIVERSAL is not set
# CONFIG_INPUT_TOUCHSCREEN_TCLM is not set
CONFIG_INPUT_TOUCHSCREEN_TCLMV2=y
# CONFIG_TOUCHSCREEN_SEC_TS is not set
CONFIG_TOUCHSCREEN_SEC_TS_Y771=y
CONFIG_INPUT_WACOM=y
CONFIG_EPEN_WACOM_W9018=y
# CONFIG_MFD_MAX77865 is not set
CONFIG_CAMERA_CIS_3M3_OBJ=y
# CONFIG_OIS_USE_RUMBA_S4 is not set
# CONFIG_CAMERA_STAR is not set
# CONFIG_CAMERA_STAR2 is not set
CONFIG_CAMERA_CROWN=y
CONFIG_OIS_USE_RUMBA_S6=y
CONFIG_SUPPORT_DIM_FLASH=y
CONFIG_SELF_MOVE_3PX=y
# CONFIG_FUELGAUGE_MAX77865 is not set
# CONFIG_CHARGER_MAX77865 is not set
CONFIG_WIRELESS_FIRMWARE_65=y
CONFIG_SENSORS_SSP_AK09918=y
CONFIG_SENSORS_SSP_LIGHT_MAX_GAIN_2BYTE=y
# CONFIG_SENSORS_SSP_STAR is not set
CONFIG_SENSORS_SSP_CROWN=y
CONFIG_MACH_EXYNOS9810_CROWNLTE_EUR_OPEN=y
# CONFIG_MACH_EXYNOS9810_STARLTE_EUR_OPEN is not set
# CONFIG_MACH_EXYNOS9810_STAR2LTE_EUR_OPEN is not set
```

## arch/arm64/configs/eur_defconfig
```kconfig
#
#
# International Defconfig
#
#
CONFIG_WLAN_REGION_CODE=100
# CONFIG_MEDIA_RADIO_SUPPORT is not set
# CONFIG_TDMB is not set
# CONFIG_TDMB_NOTIFIER is not set
```

## arch/arm64/configs/kor_defconfig
```kconfig
#
#
# Korean Defconfig
#
#
CONFIG_WLAN_REGION_CODE=200
CONFIG_MEDIA_RADIO_SUPPORT=y
CONFIG_RADIO_ADAPTERS=y
# CONFIG_RADIO_SI470X is not set
# CONFIG_RADIO_SI4713 is not set
CONFIG_RADIO_RTC6213N=y
CONFIG_I2C_RTC6213N=y
# CONFIG_USB_MR800 is not set
# CONFIG_USB_DSBR is not set
# CONFIG_RADIO_MAXIRADIO is not set
# CONFIG_RADIO_SHARK is not set
# CONFIG_RADIO_SHARK2 is not set
# CONFIG_USB_KEENE is not set
# CONFIG_USB_RAREMONO is not set
# CONFIG_USB_MA901 is not set
# CONFIG_RADIO_TEA5764 is not set
# CONFIG_RADIO_SAA7706H is not set
# CONFIG_RADIO_TEF6862 is not set
# CONFIG_RADIO_WL1273 is not set
CONFIG_MEDIA_ATTACH=y
CONFIG_MEDIA_TUNER=y
CONFIG_MEDIA_TUNER_SIMPLE=y
CONFIG_MEDIA_TUNER_TDA8290=y
CONFIG_MEDIA_TUNER_TDA827X=y
CONFIG_MEDIA_TUNER_TDA18271=y
CONFIG_MEDIA_TUNER_TDA9887=y
CONFIG_MEDIA_TUNER_TEA5761=y
CONFIG_MEDIA_TUNER_TEA5767=y
CONFIG_MEDIA_TUNER_MT20XX=y
CONFIG_MEDIA_TUNER_XC2028=y
CONFIG_MEDIA_TUNER_XC5000=y
CONFIG_MEDIA_TUNER_XC4000=y
CONFIG_MEDIA_TUNER_MC44S803=y
CONFIG_TDMB=y
CONFIG_TDMB_VENDOR_FCI=y
CONFIG_TDMB_FC8080=y
# CONFIG_TDMB_VENDOR_RAONTECH is not set
# CONFIG_TDMB_QUALCOMM is not set
CONFIG_TDMB_SLSI=y
CONFIG_TDMB_SPI=y
# CONFIG_TDMB_EBI is not set
# CONFIG_TDMB_TSIF_SLSI is not set
# CONFIG_TDMB_TSIF_QC is not set
# CONFIG_TDMB_I2C is not set
CONFIG_TDMB_XTAL_FREQ=y
# CONFIG_TDMB_DEBUG is not set
# CONFIG_TDMB_ANT_DET is not set
# CONFIG_TDMB_VREG_SUPPORT is not set
CONFIG_TDMB_NOTIFIER=y
CONFIG_SUPPORT_TDMB_TUNE=y
```
